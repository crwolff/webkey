## sdkconfig.defaults
```kconfig
#CONFIG_LWIP_LOCAL_HOSTNAME="Default_Hostname"
#CONFIG_ESP_WIFI_SSID="Default_SSID"
#CONFIG_ESP_WIFI_PASSWORD="Default_Password"

CONFIG_ESP_COREDUMP_ENABLE_TO_UART=y

CONFIG_IDF_CMAKE=y
CONFIG_IDF_TARGET="esp32s2"
CONFIG_IDF_TARGET_ESP32S2=y

CONFIG_FREERTOS_WATCHPOINT_END_OF_STACK=y
CONFIG_FREERTOS_SUPPORT_STATIC_ALLOCATION=y

CONFIG_PARTITION_TABLE_TWO_OTA=y
CONFIG_ESPTOOLPY_FLASHSIZE_4MB=y
CONFIG_ESPTOOLPY_FLASHSIZE="4MB"
```
